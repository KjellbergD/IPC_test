## conf/layer.conf
```bitbake
# We have a conf and classes directory, add to BBPATH
BBPATH .= ":${LAYERDIR}"

# We have recipes-* directories, add to BBFILES
BBFILES += "${LAYERDIR}/*.bb \
            ${LAYERDIR}/*.bbappend"

BBFILE_COLLECTIONS += "meta-dipp-experiments"
BBFILE_PATTERN_meta-dipp-experiments = "^${LAYERDIR}/"
BBFILE_PRIORITY_meta-dipp-experiments = "5"

LAYERDEPENDS_meta-dipp-experiments = "core"
LAYERSERIES_COMPAT_meta-dipp-experiments = "kirkstone"
```
